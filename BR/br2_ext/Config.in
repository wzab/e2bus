## BR/br2_ext/Config.in
```kconfig
source "$BR2_EXTERNAL_E2B_MINI_PATH/package/e2bus-module/Config.in"
source "$BR2_EXTERNAL_E2B_MINI_PATH/package/e2test/Config.in"
```

## BR/br2_ext/package/e2bus-module/Config.in
```kconfig
config BR2_PACKAGE_E2BUS_MODULE
	bool "e2bus-module"
	depends on BR2_LINUX_KERNEL
	help
          my first module

          http://www.nowhere

comment "e2bus-module needs a Linux kernel to be built"
	depends on !BR2_LINUX_KERNEL
```

## BR/br2_ext/package/e2test/Config.in
```kconfig
config BR2_PACKAGE_E2TEST
	bool "e2test"
	select BR2_PACKAGE_ZEROMQ
	help
	  E2BUS test application

	  http://github.com/wzab/e2bus
```

## OWRT/drv-e2bus/src/Kconfig
```kconfig
config DRV_E2BUS
	tristate "Driver for E2Bus"
	help
	  Driver for E2Bus protocol
```
